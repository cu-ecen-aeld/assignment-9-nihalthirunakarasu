## base_external/package/aesd-assignments/Config.in
```kconfig
config BR2_PACKAGE_AESD_ASSIGNMENTS
	bool "aesd-assignments"
	help
	  Includes the writer executable, finder.sh and tester.sh in the kernel image.
	  Also holds the aesdsocket assignment. Which will be copied to the target to run on boot.
	  Used to understand buildroot external trees and package builds.
```

## base_external/package/aesd-char-driver/Config.in
```kconfig
config BR2_PACKAGE_AESD_CHAR_DRIVER
	bool "aesd-char-driver"
	help
	  Circular buffer based driver implementation. Character device driver.
```

## base_external/package/ldd/Config.in
```kconfig
config BR2_PACKAGE_LDD
	bool "ldd"
	help
	  Includes the misc-modules and scull modules. Copying the module_load, module_unload, scull_load and scull_unload.
	  Used to understand buildroot.
```
